## components/audio/Kconfig.projbuild
```kconfig
menu "Audio output configuration"

    config LRCLK_PIN_NUM
        int "Pin number to use for the L/R clock signal"
        default 3

    config BCLK_PIN_NUM
        int "Pin number to use for the bit clock signal"
        default 8

    config DATA_PIN_NUM
        int "Pin number to use for the data signal"
        default 18

endmenu
```

## components/board/Kconfig.projbuild
```kconfig
menu "Talky Toaster Hardware"

    choice BOARD_VERSION
        prompt "Circuit board version"
        default BREADBOARD_V1_0
        help
            Select a hardware definition to build the firmware for
    
    config BREADBOARD_V1_0
        bool "Breadboard v1.0"
    
    config PERFBOARD_V1_1
        bool "Perfboard v1.1"

    endchoice
    
 endmenu
    
```

## sdkconfig.defaults.esp32s3
```kconfig
CONFIG_IDF_CMAKE=y
CONFIG_IDF_TARGET_ARCH_XTENSA=y
CONFIG_IDF_TARGET="esp32s3"
CONFIG_IDF_TARGET_ESP32S3=y
CONFIG_IDF_FIRMWARE_CHIP_ID=0x0009
CONFIG_ESPTOOLPY_FLASHSIZE_16MB=y
CONFIG_ESP_DEFAULT_CPU_FREQ_MHZ_240=y
CONFIG_ESP_DEFAULT_CPU_FREQ_MHZ=240

CONFIG_ESPTOOLPY_FLASHMODE="qio"
CONFIG_ESPTOOLPY_FLASHMODE_QIO=y
CONFIG_SPIRAM=y
CONFIG_SPIRAM_MODE_OCT=y
CONFIG_SPIRAM_TYPE_AUTO=y
CONFIG_SPIRAM_SPEED_80M=y
CONFIG_SPIRAM_SPEED=80
```
